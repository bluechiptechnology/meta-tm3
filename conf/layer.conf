## conf/layer.conf
```bitbake
# We have a conf and classes directory, add to BBPATH
BBPATH .= ":${LAYERDIR}"

# We have recipes-* directories, add to BBFILES
BBFILES += "${LAYERDIR}/recipes-*/*/*.bb \
            ${LAYERDIR}/recipes-*/*/*.bbappend"

BBFILE_COLLECTIONS += "meta-tm3"
BBFILE_PATTERN_meta-tm3 = "^${LAYERDIR}/"
BBFILE_PRIORITY_meta-tm3 = "6"

LAYERDEPENDS_meta-tm3 = "core meta-arm"
LAYERSERIES_COMPAT_meta-tm3 = "mickledore" 
```

## conf/machine/tm3.conf
```bitbake
DEFAULTTUNE ?= "cortexa53-crypto"

require conf/machine/include/arm/armv8a/tune-cortexa53.inc

PREFERRED_PROVIDER_virtual/kernel ?= "linux-tm3"
PREFERRED_PROVIDER_u-boot ?= "u-boot"
PREFERRED_PROVIDER_virtual/bootloader ?= "u-boot"

KERNEL_IMAGETYPE ?= "Image"

UBOOT_LOCALVERSION = "-g${@d.getVar('SRCPV', True).partition('+')[2][0:7]}"
UBOOT_ENTRYPOINT ?= "0x40008000"
SPL_BINARY ?= "u-boot-sunxi-with-spl.bin"

IMAGE_FSTYPES += "ext3 tar.gz wic.gz wic.bmap"

IMAGE_BOOT_FILES ?= "${KERNEL_IMAGETYPE} boot.scr tm3-hb8-7-c.dtb tm3-hb8-9-c.dtb tm3-hb8-12-c.dtb tm3-hb8-7-r.dtb"
CORE_IMAGE_EXTRA_INSTALL += "i2c-tools kernel-modules"
IMAGE_INSTALL:append = " iw \
                         networkmanager \
                         networkmanager-nmcli \
                         wpa-supplicant \
                         wireless-regdb-static \
                         linux-firmware-tm3-wifi \
                         display"

WKS_FILES ?= "sunxi-sdcard-image.wks.in"
WKS_FILE_DEPENDS ?= "virtual/kernel u-boot"

KERNEL_DEVICETREE = "sunxi/tm3-hb8-7-c.dtb sunxi/tm3-hb8-9-c.dtb sunxi/tm3-hb8-12-c.dtb sunxi/tm3-hb8-7-r.dtb"

SERIAL_CONSOLES ?= "115200;ttyS0"
SERIAL_CONSOLES_CHECK = "${SERIAL_CONSOLES}"

INIT_MANAGER = "systemd"
```

## recipes-bsp/u-boot/files/tm3_defconfig
```kconfig
CONFIG_ARM=y
CONFIG_ARCH_SUNXI=y
CONFIG_DEFAULT_DEVICE_TREE="sun50i-h6-bct-tm3"
CONFIG_SPL=y
CONFIG_MACH_SUN50I_H6=y
CONFIG_SUNXI_DRAM_H6_DDR3_1333=y
CONFIG_DRAM_CLK=648
CONFIG_MMC0_CD_PIN="PG11"
CONFIG_MMC_SUNXI_SLOT_EXTRA=2
CONFIG_OF_LIBFDT=y
CONFIG_OF_LIBFDT_OVERLAY=y

CONFIG_SPL_SPI_SUNXI=y
CONFIG_SYS_I2C_MVTWSI=y
CONFIG_SPL_I2C=y
CONFIG_DM_I2C=y
CONFIG_CMD_I2C=y

CONFIG_POWER=y
CONFIG_POWER_I2C=y
CONFIG_PMIC_CHILDREN=y
CONFIG_DM_PMIC=y
CONFIG_SPL_DM_PMIC=y
CONFIG_PMIC_AXP=y
CONFIG_SPL_PMIC_AXP=y
CONFIG_CMD_PMIC=y
CONFIG_CMD_REGULATOR=y
CONFIG_AXP_PMIC_BUS=y

CONFIG_DM_REGULATOR=y
CONFIG_CMD_REGULATOR=y
CONFIG_REGULATOR_AXP=y
CONFIG_SPL_REGULATOR_AXP=y

CONFIG_REGMAP=y
CONFIG_SPL_REGMAP=y
CONFIG_CLK=y
CONFIG_CLK_SUNXI=y
CONFIG_CMD_CLK=y
CONFIG_DM_RESET=y
CONFIG_CLK_SUN50I_H6=y
CONFIG_CLK_SUN50I_H6_R=y
```
